## firmware/Kconfig.projbuild
```kconfig
menu "Smart Garland Configuration"

    menu "LED Configuration"
        config GARLAND_LED_GPIO
            int "LED Data GPIO Pin"
            default 8
            help
                GPIO pin connected to WS2812B data line.

        config GARLAND_LED_COUNT
            int "Number of LEDs"
            default 1
            range 1 1000
            help
                Total number of LEDs in the strip.
    endmenu

    menu "Effects Configuration"
        config GARLAND_EFFECTS_ENABLED
            bool "Enable Animation Effects"
            default n
            help
                Enable animation effects engine (rainbow, fade, etc.)

        config GARLAND_EFFECTS_FPS
            int "Animation FPS"
            default 30
            range 10 120
            depends on GARLAND_EFFECTS_ENABLED
            help
                Frames per second for animations.
    endmenu

    menu "Segmentation"
        config GARLAND_SEGMENTS_ENABLED
            bool "Enable LED Segmentation"
            default n
            help
                Enable independent control of LED segments.

        config GARLAND_MAX_SEGMENTS
            int "Maximum Segments"
            default 4
            range 1 16
            depends on GARLAND_SEGMENTS_ENABLED
    endmenu

endmenu
```

## firmware/sdkconfig.defaults
```kconfig
# Common configuration for Smart Garland

# Partition table
CONFIG_PARTITION_TABLE_CUSTOM=y
CONFIG_PARTITION_TABLE_CUSTOM_FILENAME="partitions.csv"

# Matter configuration
CONFIG_CHIP_DEVICE_PRODUCT_NAME="Smart Garland"
CONFIG_CHIP_DEVICE_VENDOR_ID=0xFFF1
CONFIG_CHIP_DEVICE_PRODUCT_ID=0x8001

# Logging
CONFIG_LOG_DEFAULT_LEVEL_INFO=y

# FreeRTOS
CONFIG_FREERTOS_HZ=1000
CONFIG_FREERTOS_ENABLE_BACKWARD_COMPATIBILITY=y

# mbedTLS
CONFIG_MBEDTLS_DYNAMIC_BUFFER=y
CONFIG_MBEDTLS_DYNAMIC_FREE_PEER_CERT=y
CONFIG_MBEDTLS_DYNAMIC_FREE_CONFIG_DATA=y

# LWIP
CONFIG_LWIP_IPV6_NUM_ADDRESSES=8
CONFIG_LWIP_MULTICAST_PING=y
```

## firmware/sdkconfig.defaults.c6_thread
```kconfig
# ESP32-C6 Thread configuration

# Disable WiFi (Thread only)
CONFIG_ENABLE_WIFI_STATION=n
CONFIG_ENABLE_WIFI_AP=n

# OpenThread configuration
CONFIG_OPENTHREAD_ENABLED=y
CONFIG_OPENTHREAD_SRP_CLIENT=y
CONFIG_OPENTHREAD_DNS_CLIENT=y
CONFIG_OPENTHREAD_LOG_LEVEL_NOTE=y
CONFIG_OPENTHREAD_FTD=y

# Thread network settings
CONFIG_OPENTHREAD_NETWORK_NAME="OpenThread"
CONFIG_OPENTHREAD_NETWORK_CHANNEL=15
CONFIG_OPENTHREAD_NETWORK_PANID=0x1234

# mDNS for Thread
CONFIG_USE_MINIMAL_MDNS=n
CONFIG_ENABLE_EXTENDED_DISCOVERY=y

# Matter over Thread
CONFIG_CHIP_ENABLE_CHIPOBLE_PAIRING=y
```

## firmware/sdkconfig.defaults.h2_thread
```kconfig
# ESP32-H2 Thread configuration

# OpenThread configuration (MTD for lower memory usage)
CONFIG_OPENTHREAD_ENABLED=y
CONFIG_OPENTHREAD_SRP_CLIENT=y
CONFIG_OPENTHREAD_DNS_CLIENT=y
CONFIG_OPENTHREAD_LOG_LEVEL_WARN=y
CONFIG_OPENTHREAD_MTD=y

# Thread network settings
CONFIG_OPENTHREAD_NETWORK_NAME="OpenThread"
CONFIG_OPENTHREAD_NETWORK_CHANNEL=15
CONFIG_OPENTHREAD_NETWORK_PANID=0x1234

# mDNS for Thread
CONFIG_USE_MINIMAL_MDNS=n
CONFIG_ENABLE_EXTENDED_DISCOVERY=y

# Matter over Thread
CONFIG_CHIP_ENABLE_CHIPOBLE_PAIRING=y

# Memory optimizations for H2
CONFIG_FREERTOS_IDLE_TASK_STACKSIZE=2048
```

## sdkconfig.defaults
```kconfig
# Smart Garland - ESP32-C6 Matter-over-Thread Configuration
# Based on esp-matter/examples/light/sdkconfig.defaults.c6_thread

CONFIG_IDF_TARGET="esp32c6"

# libsodium (CONFIG_LIBSODIUM_USE_MBEDTLS_SHA removed in v5.4)

# NIMBLE
CONFIG_BT_ENABLED=y
CONFIG_BT_NIMBLE_ENABLED=y
CONFIG_BT_NIMBLE_EXT_ADV=n
CONFIG_BT_NIMBLE_TRANSPORT_EVT_SIZE=70
CONFIG_USE_BLE_ONLY_FOR_COMMISSIONING=n

# Enable OpenThread
CONFIG_OPENTHREAD_ENABLED=y
CONFIG_OPENTHREAD_SRP_CLIENT=y
CONFIG_OPENTHREAD_DNS_CLIENT=y
CONFIG_OPENTHREAD_LOG_LEVEL_DYNAMIC=n
CONFIG_OPENTHREAD_LOG_LEVEL_NOTE=y
CONFIG_OPENTHREAD_CLI=n

# Thread Device Role - MTD only (per ADR-002)
CONFIG_OPENTHREAD_MTD=y

# Disable lwip ipv6 autoconfig
CONFIG_LWIP_IPV6_AUTOCONFIG=n

# Use a custom partition table
CONFIG_PARTITION_TABLE_CUSTOM=y
CONFIG_PARTITION_TABLE_CUSTOM_FILENAME="partitions.csv"

# LwIP config for OpenThread
CONFIG_LWIP_IPV6_NUM_ADDRESSES=8
CONFIG_LWIP_MULTICAST_PING=y

# MDNS platform
CONFIG_USE_MINIMAL_MDNS=n
CONFIG_ENABLE_EXTENDED_DISCOVERY=y

# Enable OTA Requestor
CONFIG_ENABLE_OTA_REQUESTOR=y

# Disable WiFi completely for Thread-only
CONFIG_ENABLE_WIFI_STATION=n
CONFIG_WIFI_NETWORK_ENDPOINT_ID=0
CONFIG_THREAD_NETWORK_ENDPOINT_ID=1

# Enable chip shell for debugging
CONFIG_ENABLE_CHIP_SHELL=y

# mbedTLS for Matter crypto
CONFIG_MBEDTLS_HKDF_C=y

# Flash size (8MB on devkit)
CONFIG_ESPTOOLPY_FLASHSIZE_8MB=y

# Device Information (for development/testing)
CONFIG_DEVICE_VENDOR_ID=0xFFF1
CONFIG_DEVICE_PRODUCT_ID=0x8001
CONFIG_DEVICE_VENDOR_NAME="Smart Home DIY"
CONFIG_DEVICE_PRODUCT_NAME="Smart Garland"
CONFIG_DEVICE_TYPE_ID=0x010D
CONFIG_DEVICE_HARDWARE_VERSION=1
CONFIG_DEVICE_SOFTWARE_VERSION=1
```
